## CMakeLists.txt
```
cmake_minimum_required(VERSION 3.20.0)
find_package(Zephyr REQUIRED HINTS $ENV{ZEPHYR_BASE})
project(mouse_radio_logger)
target_sources(app PRIVATE src/main.c)
option(DISCOVERY_PROBE "Bounded experimental discovery and data ACK probe" OFF)
option(WIRELESS_HID "Bounded wireless mouse USB HID output" OFF)
option(NORMAL_DONGLE "Automatic continuous receiver without a serial reader" OFF)
option(LATENCY_DIAGNOSTICS "Quiet fixed-memory radio/USB timing with stopped-only dump" OFF)
option(FAST_POLL_DIAGNOSTICS "Compare 10us polling in the timing image only" OFF)
option(INPUT_CONSERVATION "Compare accepted mouse input totals with host capture" OFF)
option(USB_PHASE_DIAGNOSTICS "Hardware SOF phase with accepted input accounting" OFF)
option(RF_CONFIG_READ_DIAGNOSTICS "One fixed RF version read without pointer output" OFF)
option(RF_CONFIG_HID_DIAGNOSTICS "Host-triggered Feature report version read with prototype identity" OFF)
option(AUX_HID_FORWARDING "Auxiliary USB HID forwarding for keyboard, consumer, system and vendor notifications" OFF)
option(CORE_PROTO_FULL "Combined Mouse, Vendor Config Feature, and Auxiliary HID with CORE startup allowlist" OFF)
if(CORE_PROTO_FULL AND (NOT RF_CONFIG_HID_DIAGNOSTICS OR NOT AUX_HID_FORWARDING))
  message(FATAL_ERROR "CORE proto requires both config HID and auxiliary HID forwarding")
endif()
if(AUX_HID_FORWARDING AND NOT NORMAL_DONGLE)
  message(FATAL_ERROR "Auxiliary HID forwarding requires the normal dongle startup path")
endif()
if(RF_CONFIG_HID_DIAGNOSTICS AND NOT RF_CONFIG_READ_DIAGNOSTICS)
  message(FATAL_ERROR "Config HID requires the read-only RF diagnostic")
endif()
if(RF_CONFIG_READ_DIAGNOSTICS AND (NOT LATENCY_DIAGNOSTICS OR USB_PHASE_DIAGNOSTICS))
  message(FATAL_ERROR "Config read requires quiet timing transport, without phase diagnostics")
endif()
if(USB_PHASE_DIAGNOSTICS AND (NOT LATENCY_DIAGNOSTICS OR NOT INPUT_CONSERVATION))
  message(FATAL_ERROR "USB phase requires latency and input diagnostics")
endif()
if(INPUT_CONSERVATION AND NOT LATENCY_DIAGNOSTICS)
  message(FATAL_ERROR "Input conservation requires latency diagnostics")
endif()
if(FAST_POLL_DIAGNOSTICS AND NOT LATENCY_DIAGNOSTICS)
  message(FATAL_ERROR "Fast polling is only an instrumented diagnostic experiment")
endif()
if(LATENCY_DIAGNOSTICS AND NOT NORMAL_DONGLE)
  message(FATAL_ERROR "Latency diagnostics requires the normal dongle startup path")
endif()
if(NORMAL_DONGLE AND NOT WIRELESS_HID)
  message(FATAL_ERROR "Normal dongle requires wireless HID")
endif()
if(WIRELESS_HID AND NOT DISCOVERY_PROBE)
  message(FATAL_ERROR "Wireless HID requires the bounded discovery probe")
endif()
if(DISCOVERY_PROBE)
  target_compile_definitions(app PRIVATE DISCOVERY_PROBE=1)
endif()
if(WIRELESS_HID)
  target_compile_definitions(app PRIVATE WIRELESS_HID=1)
endif()
if(NORMAL_DONGLE)
  target_compile_definitions(app PRIVATE NORMAL_DONGLE=1)
endif()
if(LATENCY_DIAGNOSTICS)
  target_compile_definitions(app PRIVATE LATENCY_DIAGNOSTICS=1)
endif()
if(FAST_POLL_DIAGNOSTICS)
  target_compile_definitions(app PRIVATE FAST_POLL_DIAGNOSTICS=1)
endif()
if(INPUT_CONSERVATION)
  target_compile_definitions(app PRIVATE INPUT_CONSERVATION=1)
endif()

if(USB_PHASE_DIAGNOSTICS)
  target_compile_definitions(app PRIVATE USB_PHASE_DIAGNOSTICS=1)
endif()
if(RF_CONFIG_READ_DIAGNOSTICS)
  target_compile_definitions(app PRIVATE RF_CONFIG_READ_DIAGNOSTICS=1)
endif()
if(RF_CONFIG_HID_DIAGNOSTICS)
  target_compile_definitions(app PRIVATE RF_CONFIG_HID_DIAGNOSTICS=1)
endif()
if(AUX_HID_FORWARDING)
  target_compile_definitions(app PRIVATE AUX_HID_FORWARDING=1)
endif()
if(CORE_PROTO_FULL)
  target_compile_definitions(app PRIVATE CORE_PROTO_FULL=1)
endif()
```

## prj.conf
```kconfig
CONFIG_BOARD_SERIAL_BACKEND_CDC_ACM=y
CONFIG_SERIAL=y
CONFIG_CONSOLE=y
CONFIG_UART_CONSOLE=y
CONFIG_UART_LINE_CTRL=y
CONFIG_USB_DEVICE_STACK=y
CONFIG_USB_DEVICE_INITIALIZE_AT_BOOT=n
CONFIG_USB_DEVICE_PRODUCT="DIY Mouse RX Logger"
# Zephyr sample IDs are only for this local diagnostic build.
CONFIG_USB_DEVICE_VID=0x2FE3
CONFIG_USB_DEVICE_PID=0x0001
CONFIG_GPIO=y
CONFIG_MAIN_STACK_SIZE=2048
CONFIG_ASSERT=y
```

## aux-hid.conf
```kconfig
CONFIG_USB_DEVICE_PRODUCT="DIY Mouse Aux HID v26"
CONFIG_USB_HID_DEVICE_COUNT=2
```

## config-hid.conf
```kconfig
CONFIG_USB_DEVICE_PRODUCT="DIY Mouse Config HID v25"
CONFIG_USB_HID_DEVICE_COUNT=2
```

## config-read.conf
```kconfig
CONFIG_USB_DEVICE_PRODUCT="DIY Mouse Config Read v20"
```

## core-id.conf
```kconfig
# Opt-in local build for Glorious CORE compatibility testing only.
# Reuses exact hardware-qualified v27 C source; updater/bootloader/address/pairing remain rejected.
CONFIG_USB_DEVICE_VID=0x258A
CONFIG_USB_DEVICE_PID=0x2031
CONFIG_USB_DEVICE_MANUFACTURER="Glorious"
CONFIG_USB_DEVICE_PRODUCT="Series One PRO Wireless"
CONFIG_USB_HID_DEVICE_COUNT=3
```

## core-proto.conf
```kconfig
CONFIG_USB_DEVICE_PRODUCT="DIY Mouse CORE Proto v27"
CONFIG_USB_HID_DEVICE_COUNT=3
```

## dongle.conf
```kconfig
# Normal operation must not wait for a CDC reader or block on console output.
CONFIG_UART_CONSOLE=n
CONFIG_PRINTK=n
CONFIG_BOOT_BANNER=n
CONFIG_USB_DEVICE_PRODUCT="DIY Mouse Dongle v14"
```

## src/main.c
```c
#include <errno.h>
#include <stdint.h>
#include <string.h>
#include <zephyr/device.h>
#include <zephyr/drivers/clock_control.h>
#include <zephyr/drivers/clock_control/nrf_clock_control.h>
#include <zephyr/drivers/gpio.h>
#include <zephyr/drivers/uart.h>
#include <zephyr/kernel.h>
#include <zephyr/sys/onoff.h>
#include <zephyr/sys/__assert.h>
#include <zephyr/sys/printk.h>
#include <zephyr/usb/usb_device.h>
#include <nrfx.h>
#include "radio_parameters.h"
#ifdef DISCOVERY_PROBE
#include "timing_device.h"
#endif
#ifdef LATENCY_DIAGNOSTICS
#ifdef INPUT_CONSERVATION
#include "input_totals.h"
#endif
static uint32_t latency_clock_us(void)
{
    PROBE_TIMER->TASKS_CAPTURE[3] = 1;
    return PROBE_TIMER->CC[3];
}
#ifdef USB_PHASE_DIAGNOSTICS
static uint32_t latency_sof_us(void) { return PROBE_TIMER->CC[4]; }
#endif
#include "latency_metrics.h"
#include "latency_dump.h"
#endif
#ifdef RF_CONFIG_READ_DIAGNOSTICS
#include "config_read.h"
static struct config_read config_read_state;

/* Uses the existing bounded CDC writer, only after x has stopped RF. */
static int config_read_dump(const struct device *console)
{
    char line[200];
    int64_t deadline = k_uptime_get() + 2000;
    snprintk(line, sizeof(line), "CONFIG_READ_V1 started=%u offset=%u attempts=%u bytes=%u complete=%u failed=%u\n",
             config_read_state.started, config_read_state.offset, config_read_state.attempts,
             config_read_state.received, config_read_state.complete, config_read_state.failed);
    int err = latency_write_line(console, line, deadline);
    if (err) return err;
    strcpy(line, "CONFIG_REPLY ");
    for (unsigned int i = 0; i < config_read_state.received; i++) {
        snprintk(line + 13 + i * 2, sizeof(line) - 13 - i * 2, "%02x", config_read_state.response[i]);
    }
    strcat(line, "\nCONFIG_END\n");
    return latency_write_line(console, line, deadline);
}
#endif
#ifdef WIRELESS_HID
#include <zephyr/drivers/usb/udc_buf.h>
#include <zephyr/sys/atomic.h>
#include <zephyr/sys/reboot.h>
#include <zephyr/usb/class/usb_hid.h>
#include "wireless_hid.h"
#endif
#ifdef RF_CONFIG_HID_DIAGNOSTICS
#include "config_hid.h"
#endif

static const struct gpio_dt_spec led = GPIO_DT_SPEC_GET(DT_ALIAS(led0), gpios);
static uint8_t packet[65] __aligned(4);
static uint32_t good, bad, invalid;
static struct onoff_client hf_client;

BUILD_ASSERT(ARRAY_SIZE(channels) == 19);
BUILD_ASSERT((OBSERVED_PCNF1 & 0xff) == sizeof(packet) - 1);
BUILD_ASSERT(!IS_ENABLED(CONFIG_BT) && !IS_ENABLED(CONFIG_IEEE802154));

static int disable_radio(void)
{
    NRF_RADIO->SHORTS = 0;
    if (NRF_RADIO->STATE == RADIO_STATE_STATE_Disabled) {
        return 0;
    }
    NRF_RADIO->EVENTS_DISABLED = 0;
    NRF_RADIO->TASKS_DISABLE = 1;
    for (int i = 0; i < 1000; i++) {
        if (NRF_RADIO->EVENTS_DISABLED) {
            return 0;
        }
        k_busy_wait(10);
    }
    return -ETIMEDOUT;
}

static void start_rx(void)
{
    memset(packet, 0, sizeof(packet));
    NRF_RADIO->EVENTS_END = 0;
    NRF_RADIO->EVENTS_DISABLED = 0;
    NRF_RADIO->SHORTS = RADIO_SHORTS_READY_START_Msk | RADIO_SHORTS_END_DISABLE_Msk;
    __DMB();
    NRF_RADIO->TASKS_RXEN = 1;
}

#ifdef DISCOVERY_PROBE
#include "probe_timing.h"
#include "discovery_probe.h"
#endif

static int listen(uint8_t channel, bool pairing_address)
{
#ifdef DISCOVERY_PROBE
#ifdef WIRELESS_HID
    receiver_poll_commands();
#else
    poll_probe_arm();
#endif
#endif
    int err = disable_radio();
    if (err) {
        return err;
    }
    NRF_RADIO->BASE1 = pairing_address ? 0x89abcdefu : MOUSE_BASE;
    NRF_RADIO->FREQUENCY = channel;
    start_rx();
    int64_t deadline = k_uptime_get() + 40;
    while (
#ifdef NORMAL_DONGLE
           probe_sent ||
#endif
           k_uptime_get() < deadline) {
#ifdef WIRELESS_HID
        receiver_poll_commands();
        if (receiver_disarm_requested && !receiver_disarm_handled) {
            return receiver_handle_disarm();
        }
        if (!atomic_get(&wireless_hid_online)) {
            disable_radio();
            return -ENODEV;
        }
        if (receiver_link_should_stop()) {
            err = disable_radio();
            return err ? err : receiver_end_link();
        }
#endif
        if (NRF_RADIO->EVENTS_END) {
            err = disable_radio();
            if (err) {
                return err;
            }
            __DMB();
            uint8_t length = packet[0];
            if (length > sizeof(packet) - 1) {
                invalid++;
            } else if (NRF_RADIO->CRCSTATUS) {
                good++;
#ifdef DISCOVERY_PROBE
                if (probe_discovery_allowed() &&
                    is_discovery(packet, channel, pairing_address,
                                 NRF_RADIO->RXMATCH)) {
                    err = send_probe();
                    if (err) {
                        printk("ERROR probe transmit %d; no retry\n", err);
                        return err;
                    }
                    /* shortcut: stay on observed channel51; trace hopping before a sustained receiver. */
                    channel = channels[3];
                    NRF_RADIO->FREQUENCY = channel;
#ifdef WIRELESS_HID
                    deadline = ack_deadline;
                    printk("RECEIVER link started: discovery=%u/%u ACKs=%u/%u session_remaining_ms=%lld\n",
                           receiver_discoveries, RECEIVER_DISCOVERY_LIMIT, ack_count,
                           PROBE_ACK_LIMIT, receiver_session_deadline - k_uptime_get());
#else
                    deadline = k_uptime_get() + PROBE_DATA_WINDOW_MS;
                    printk("PROBE sent once: group=0 interval=500; listening ch=%u for %u ms\n",
                           channel, PROBE_DATA_WINDOW_MS);
#endif
                    /* Receive only after logging so an ACK never targets a packet queued during USB output. */
                    start_rx();
                    continue;
                }
                if (probe_ack_budget_remaining() && probe_ack_window_open() &&
                    is_ack_candidate(packet, channel, pairing_address, NRF_RADIO->RXMATCH)) {
                    err = send_report_ack(packet);
#ifdef WIRELESS_HID
                    if (err == -EAGAIN) {
                        /* Count backpressure without USB text in active RF processing. */
                        start_rx();
                        continue;
                    }
                    if (err == -EACCES && receiver_link_should_stop()) {
                        err = disable_radio();
                        return err ? err : receiver_end_link();
                    }
#endif
                    if (err) {
                        printk("ERROR data ACK transmit %d; no retry\n", err);
                        return err;
                    }
#ifndef WIRELESS_HID
                    printk("PROBE ACK sent: count=%u/%u len=%u seq=%u next=%u\n",
                           ack_count, PROBE_ACK_LIMIT, packet[0], packet[1], ack_reply[1]);
#endif
                }
#endif
#ifdef WIRELESS_HID
                if (receiver_diagnostics_due()) {
                    printk("RECEIVER stats t=%lld good=%u bad_crc=%u invalid_len=%u ACKs=%u/%u idle=%u status=%u type1=%u hid_reports=%u retries=%u busy=%u\n",
                           k_uptime_get(), good, bad, invalid, ack_count, PROBE_ACK_LIMIT,
                           receiver_idle_acks, receiver_status_acks, receiver_type1_acks,
                           wireless_hid_reports, wireless_hid_retries, wireless_hid_busy);
                }
#else
                printk("RX t=%lld ch=%u base=%s match=%u len=%u data=",
                       k_uptime_get(), channel, pairing_address ? "pair" : "mouse",
                       NRF_RADIO->RXMATCH, length);
                for (uint8_t i = 0; i < length; i++) {
                    printk("%02x", packet[i + 1]);
                }
                printk("\n");
#endif
            } else {
                bad++;
            }
            start_rx();
        }
        /* shortcut: polling logger misses traffic; use an IRQ ring buffer for throughput work. */
#ifdef FAST_POLL_DIAGNOSTICS
        k_busy_wait(10);
#else
        k_busy_wait(50);
#endif
        k_yield();
    }
    err = disable_radio();
#ifdef WIRELESS_HID
    if (!err && receiver_link_should_stop()) {
        return receiver_end_link();
    }
#endif
    return err;
}

int main(void)
{
    const struct device *console = DEVICE_DT_GET(DT_CHOSEN(zephyr_console));
    const struct device *clock = DEVICE_DT_GET(DT_NODELABEL(clock));
    if (!device_is_ready(console) || !device_is_ready(clock) || !gpio_is_ready_dt(&led)) {
        return -ENODEV;
    }
    int err = gpio_pin_configure_dt(&led, GPIO_OUTPUT_ACTIVE);
    if (err) {
        return err;
    }
#ifdef WIRELESS_HID
    err = init_wireless_hid();
    if (err) {
        return err;
    }
#ifdef RF_CONFIG_HID_DIAGNOSTICS
    err = init_config_hid();
    if (err) return err;
#endif
#ifdef AUX_HID_FORWARDING
    err = init_aux_hid();
    if (err) return err;
#endif
    err = usb_enable(wireless_hid_status);
#else
    err = usb_enable(NULL);
#endif
    if (err) {
        return err;
    }
#ifdef NORMAL_DONGLE
    while (!atomic_get(&wireless_hid_online)) {
        wireless_hid_restart_if_needed();
        if (atomic_get(&wireless_hid_failed)) {
            return -ENODEV;
        }
        k_sleep(K_MSEC(100));
    }
#else
    uint32_t dtr = 0;
    do {
#ifdef WIRELESS_HID
        wireless_hid_restart_if_needed();
#endif
        err = uart_line_ctrl_get(console, UART_LINE_CTRL_DTR, &dtr);
        if (err) {
            return err;
        }
        k_sleep(K_MSEC(100));
    } while (!dtr);
#endif
#ifdef DISCOVERY_PROBE
    probe_self_test();
#ifdef WIRELESS_HID
    printk("DIY Mouse Wireless HID Probe v14: explicit rearm; bounded fifteen minutes; passive USB restart; explicit x stop; quiet active; idle sequence hold; passive until 'p'; %u discoveries + %u ACKs total in %u ms; release/recover after %u ms gap\n",
           RECEIVER_DISCOVERY_LIMIT, PROBE_ACK_LIMIT, PROBE_DATA_WINDOW_MS, RECEIVER_LINK_GAP_MS);
#else
    printk("DIY Mouse Discovery Probe v9: idle/status/report ACKs; passive until 'p'; ONE discovery + %u ACKs maximum in %u ms; no HID\n",
           PROBE_ACK_LIMIT, PROBE_DATA_WINDOW_MS);
#endif
#else
    printk("DIY Mouse RX Logger v2: receive-only, no movement reports\n");
#endif
    /* Share the HFXO manager with the USB driver rather than mixing clock APIs. */
    struct onoff_manager *hf = z_nrf_clock_control_get_onoff(CLOCK_CONTROL_NRF_SUBSYS_HF);
    if (!hf) {
        printk("ERROR no HF clock manager\n");
        return -ENODEV;
    }
    sys_notify_init_spinwait(&hf_client.notify);
    err = onoff_request(hf, &hf_client);
    if (err < 0) {
        printk("ERROR HF clock request %d\n", err);
        return err;
    }
    int64_t deadline = k_uptime_get() + 1000;
    int clock_result = -EIO;
    while (sys_notify_fetch_result(&hf_client.notify, &clock_result) == -EAGAIN) {
        if (k_uptime_get() >= deadline) {
            printk("ERROR HF clock timeout\n");
            onoff_cancel_or_release(hf, &hf_client);
            return -ETIMEDOUT;
        }
        k_sleep(K_MSEC(1));
    }
    if (clock_result < 0) {
        printk("ERROR HF clock start %d\n", clock_result);
        return clock_result;
    }
    NRF_RADIO->POWER = 1;
    NRF_RADIO->INTENCLR = 0xffffffffu;
    err = disable_radio();
    if (err) {
        printk("ERROR radio disable %d\n", err);
        return err;
    }
    /* Exact setup values at stock 0x15a50..0x15ae2; address mapping still needs RF validation. */
    NRF_RADIO->MODE = 4;
    NRF_RADIO->PCNF0 = 8;
    NRF_RADIO->PCNF1 = OBSERVED_PCNF1;
    NRF_RADIO->BASE0 = OBSERVED_BASE0;
    NRF_RADIO->PREFIX0 = OBSERVED_PREFIX0;
    NRF_RADIO->RXADDRESSES = 3;
    NRF_RADIO->CRCCNF = 2;
    NRF_RADIO->CRCPOLY = OBSERVED_CRCPOLY;
    NRF_RADIO->CRCINIT = 0xffff;
    NRF_RADIO->DATAWHITEIV = 0x40;
    NRF_RADIO->PACKETPTR = (uint32_t)packet;
#ifdef DISCOVERY_PROBE
    err = init_probe_timing();
    if (err) {
        printk("ERROR probe timing initialization %d\n", err);
        return err;
    }
    printk("TIMING hardware capture initialized at 1 MHz\n");
#endif
    __ASSERT(NRF_RADIO->PCNF1 == OBSERVED_PCNF1, "Radio setup readback failed");
    printk("mode=%u pcnf0=%08x pcnf1=%08x crc=%08x channels=%u dwell_ms=40\n",
           NRF_RADIO->MODE, NRF_RADIO->PCNF0, NRF_RADIO->PCNF1, NRF_RADIO->CRCPOLY,
           (unsigned int)ARRAY_SIZE(channels));
    bool pairing_address = false;
#ifdef NORMAL_DONGLE
    if (!receiver_start_session()) {
        wireless_hid_restart_if_needed();
        return -ENODEV;
    }
#endif
    while (true) {
        for (size_t i = 0; i < ARRAY_SIZE(channels); i++) {
            err = listen(channels[i], pairing_address);
#ifdef WIRELESS_HID
            int release_err = wireless_hid_finish();
            if (release_err) {
                printk("ERROR HID release %d\n", release_err);
                if (!err) {
                    err = release_err;
                }
            }
#endif
            if (err) {
#ifdef WIRELESS_HID
                wireless_hid_restart_if_needed();
#endif
                printk("ERROR receive loop %d\n", err);
                return err;
            }
        }
        printk("SCAN base=%s good=%u bad_crc=%u invalid_len=%u\n",
               pairing_address ? "pair" : "mouse", good, bad, invalid);
        gpio_pin_toggle_dt(&led);
        pairing_address = !pairing_address;
        k_sleep(K_MSEC(1));
    }
}
```

## src/aux_hid.h
```c
/* Auxiliary HID interface: Consumer (ID 1), System Control (ID 2),
 * Keyboard (ID 3 + LED Output), and Vendor Notifications FFA0/FFFF (IDs 4/5).
 */
#ifdef RF_CONFIG_HID_DIAGNOSTICS
#define AUX_HID_DEVICE_NAME "HID_2"
#else
#define AUX_HID_DEVICE_NAME "HID_1"
#endif
#define AUX_HID_MAX_REPORT_SIZE 9u

static const uint8_t aux_hid_descriptor[] = {
    /* Report ID 1: Consumer Control (16-bit usage array, 0x0000..0x023C) */
    0x05, 0x0c, 0x09, 0x01, 0xa1, 0x01, 0x85, 0x01,
    0x19, 0x00, 0x2a, 0x3c, 0x02, 0x15, 0x00, 0x26, 0x3c, 0x02,
    0x95, 0x01, 0x75, 0x10, 0x81, 0x00, 0xc0,
    /* Report ID 2: System Control (Power Down, Sleep, Wake Up) */
    0x05, 0x01, 0x09, 0x80, 0xa1, 0x01, 0x85, 0x02,
    0x19, 0x81, 0x29, 0x83, 0x15, 0x00, 0x25, 0x01,
    0x75, 0x01, 0x95, 0x03, 0x81, 0x02, 0x95, 0x05, 0x81, 0x01, 0xc0,
    /* Report ID 3: Standard 6KRO Keyboard + 5-bit LED Output */
    0x05, 0x01, 0x09, 0x06, 0xa1, 0x01, 0x85, 0x03,
    0x05, 0x07, 0x19, 0xe0, 0x29, 0xe7, 0x15, 0x00, 0x25, 0x01,
    0x75, 0x01, 0x95, 0x08, 0x81, 0x02,
    0x95, 0x01, 0x75, 0x08, 0x81, 0x03,
    0x95, 0x05, 0x75, 0x01, 0x05, 0x08, 0x19, 0x01, 0x29, 0x05, 0x91, 0x02,
    0x95, 0x01, 0x75, 0x03, 0x91, 0x03,
    0x95, 0x06, 0x75, 0x08, 0x15, 0x00, 0x25, 0x65,
    0x05, 0x07, 0x19, 0x00, 0x29, 0x65, 0x81, 0x00, 0xc0,
    /* Report ID 4: Vendor Notification FFA0:0001 (8 bytes) */
    0x06, 0xa0, 0xff, 0x09, 0x01, 0xa1, 0x01, 0x85, 0x04,
    0x09, 0x01, 0x15, 0x00, 0x26, 0xff, 0x00, 0x75, 0x08, 0x95, 0x08, 0x81, 0x02, 0xc0,
    /* Report ID 5: Vendor Notification FFFF:0001 (8 bytes) */
    0x06, 0xff, 0xff, 0x09, 0x01, 0xa1, 0x01, 0x85, 0x05,
    0x09, 0x01, 0x15, 0x00, 0x26, 0xff, 0x00, 0x75, 0x08, 0x95, 0x08, 0x81, 0x02, 0xc0,
};

static const struct device *aux_hid_device;
static K_SEM_DEFINE(aux_hid_slot, 1, 1);
static bool aux_hid_kbd_active, aux_hid_consumer_active, aux_hid_system_active;
static unsigned int aux_hid_reports, aux_hid_busy;
UDC_STATIC_BUF_DEFINE(aux_hid_report, AUX_HID_MAX_REPORT_SIZE);
BUILD_ASSERT(sizeof(aux_hid_report) >= AUX_HID_MAX_REPORT_SIZE);

static void aux_hid_ready(const struct device *dev)
{
    ARG_UNUSED(dev);
    k_sem_give(&aux_hid_slot);
}

static int aux_hid_set_report(const struct device *dev, struct usb_setup_packet *setup,
                              int32_t *len, uint8_t **data)
{
    ARG_UNUSED(dev);
    if (!setup || !len || !data || !*data) {
        return -EINVAL;
    }
    /* Accept host Keyboard LED Output reports (Output type=2, Report ID=3). */
    if (setup->wValue == 0x0203 && (setup->wLength == 1 || setup->wLength == 2) &&
        *len == (int32_t)setup->wLength) {
        return 0;
    }
    return -ENOTSUP;
}

static int init_aux_hid(void)
{
    static const struct hid_ops ops = {
        .int_in_ready = aux_hid_ready,
        .set_report = aux_hid_set_report,
    };
    aux_hid_device = device_get_binding(AUX_HID_DEVICE_NAME);
    if (!aux_hid_device || !device_is_ready(aux_hid_device)) {
        return -ENODEV;
    }
    aux_hid_kbd_active = aux_hid_consumer_active = aux_hid_system_active = false;
    aux_hid_reports = aux_hid_busy = 0;
    usb_hid_register_device(aux_hid_device, aux_hid_descriptor,
                            sizeof(aux_hid_descriptor), &ops);
    return usb_hid_init(aux_hid_device);
}

static bool aux_hid_frame_valid(const uint8_t *p)
{
    if (p[0] < 2 || p[0] > 64) {
        return false;
    }
    if (p[0] == 2) {
        return true;
    }
    unsigned int at = 3, count = 0;
    while (at <= p[0]) {
        if (count >= 8u) {
            return false;
        }
        uint8_t header = p[at++];
        unsigned int len = (header >> 3) & 15u;
        unsigned int type = header & 7u;
        bool cont = (header & 0x80u) != 0;
        if (at + len > (unsigned int)p[0] + 1) {
            return false;
        }
        bool ok = (!cont && ((type == 1 && len == 8) || (type == 2 && len == 8) ||
                             (type == 3 && len == 2) || (type == 4 && len == 1) ||
                             (type == 5 && len == 8) || (type == 6 && len == 8)))
#ifdef CORE_PROTO_FULL
                  || (type == 7 && len == 8)
#endif
                  ;
        if (!ok) {
            return false;
        }
        at += len;
        count++;
    }
    return count > 0 && at == (unsigned int)p[0] + 1;
}

static bool aux_hid_nonzero(const uint8_t *data, size_t len)
{
    for (size_t i = 0; i < len; i++) {
        if (data[i] != 0) {
            return true;
        }
    }
    return false;
}

static int aux_hid_write(const uint8_t *report, uint32_t size, int wait_ms)
{
    if (!atomic_get(&wireless_hid_online)) {
        return -ENODEV;
    }
    if (!report || size == 0 || size > AUX_HID_MAX_REPORT_SIZE) {
        return -EINVAL;
    }
    if (k_sem_take(&aux_hid_slot, K_MSEC(wait_ms)) != 0) {
        return wait_ms ? -ETIMEDOUT : -EAGAIN;
    }
    memcpy(aux_hid_report, report, size);
    uint32_t written = 0;
    int err = hid_int_ep_write(aux_hid_device, aux_hid_report, size, &written);
    if (err) {
        k_sem_give(&aux_hid_slot);
        return err;
    }
    return written == size ? 0 : -EIO;
}

static int aux_hid_forward_record(uint8_t type, const uint8_t *payload, uint8_t len)
{
    uint8_t buf[AUX_HID_MAX_REPORT_SIZE] = {0};
    uint32_t size = 0;
    if (type == 2 && len == 8) {
        buf[0] = 0x03;
        memcpy(buf + 1, payload, 8);
        size = 9;
    } else if (type == 3 && len == 2) {
        buf[0] = 0x01;
        buf[1] = payload[0];
        buf[2] = payload[1];
        size = 3;
    } else if (type == 4 && len == 1) {
        buf[0] = 0x02;
        buf[1] = payload[0] & 0x07u;
        size = 2;
    } else if (type == 5 && len == 8) {
        buf[0] = 0x04;
        memcpy(buf + 1, payload, 8);
        size = 9;
    } else if (type == 6 && len == 8) {
        buf[0] = 0x05;
        memcpy(buf + 1, payload, 8);
        size = 9;
    } else {
        return -EINVAL;
    }
    int err = aux_hid_write(buf, size, 0);
    if (err == -EAGAIN) {
        aux_hid_busy++;
    }
    if (!err) {
        aux_hid_reports++;
        if (type == 2) {
            aux_hid_kbd_active = aux_hid_nonzero(payload, 8);
        } else if (type == 3) {
            aux_hid_consumer_active = aux_hid_nonzero(payload, 2);
        } else if (type == 4) {
            aux_hid_system_active = (buf[1] != 0);
        }
    }
    return err;
}

static int aux_hid_release_one(uint8_t report_id, uint32_t size, bool *active)
{
    if (!*active) {
        return 0;
    }
    uint8_t released[AUX_HID_MAX_REPORT_SIZE] = {0};
    released[0] = report_id;
    int err = aux_hid_write(released, size, 1000);
    if (err) {
        return err;
    }
    if (k_sem_take(&aux_hid_slot, K_MSEC(1000)) != 0) {
        return -ETIMEDOUT;
    }
    k_sem_give(&aux_hid_slot);
    *active = false;
    return 0;
}

static int aux_hid_finish(void)
{
    int err = aux_hid_release_one(0x03, 9, &aux_hid_kbd_active);
    if (err) return err;
    err = aux_hid_release_one(0x01, 3, &aux_hid_consumer_active);
    if (err) return err;
    return aux_hid_release_one(0x02, 2, &aux_hid_system_active);
}
```

## src/config_hid.h
```c
/* Prototype identity only: validate USB->RF reads before CORE may write profiles. */
static const uint8_t config_hid_descriptor[] = {
    0x06, 0xff, 0xff, 0x09, 0x00, 0xa1, 0x01, 0x09, 0x00, 0x15,
    0x00, 0x25, 0x01, 0x75, 0x08, 0x95, 0x40, 0xb1, 0x02, 0xc0,
};
static uint8_t config_hid_response[64];
UDC_STATIC_BUF_DEFINE(config_hid_snapshot, 64);
static bool config_hid_pending, config_hid_claimed, config_hid_published;
static bool config_hid_query_active;
static bool config_hid_consumed, config_hid_locked_out;
static int64_t config_hid_deadline;
static uint8_t config_hid_request[64];
#ifdef CORE_PROTO_FULL
#define CONFIG_HID_QUEUE_CAP 4u
static uint8_t config_hid_queue[CONFIG_HID_QUEUE_CAP][64];
static uint8_t config_hid_q_head, config_hid_q_count;
#endif

static void config_hid_reset(void)
{
    config_hid_pending = config_hid_claimed = config_hid_published = false;
    config_hid_query_active = false;
    config_hid_consumed = config_hid_locked_out = false;
#ifdef CORE_PROTO_FULL
    config_hid_q_head = config_hid_q_count = 0;
#endif
    memset(config_hid_response, 0, sizeof(config_hid_response));
    config_hid_response[0] = 0xa3;
}

static int config_hid_set(const struct device *dev, struct usb_setup_packet *setup,
                          int32_t *len, uint8_t **data)
{
    ARG_UNUSED(dev);
    if (!setup || !len || !data || !*data || setup->wValue != 0x0300 ||
        setup->wLength != 64 || *len != 64) return -EINVAL;
    if (!config_request_valid(*data)) return -ENOTSUP;
    unsigned int key = irq_lock();
#ifdef CORE_PROTO_FULL
    if ((*data)[2] == 0 && (*data)[4] == 0 && (*data)[5] == 0x81) {
        if (config_hid_pending && !config_hid_published) { irq_unlock(key); return -EBUSY; }
        memset(config_hid_response, 0, sizeof(config_hid_response));
        config_hid_response[0] = 0xa1;
        config_hid_response[3] = 3;
        config_hid_response[5] = 0x81;
        config_hid_response[6] = 1; /* Receiver-local firmware version 1.0.0.0 */
        config_hid_pending = config_hid_claimed = config_hid_published = true;
        config_hid_query_active = config_hid_consumed = false;
        irq_unlock(key);
        return 0;
    }
    /* Queue back-to-back SET_REPORT calls (e.g. OpenMouse setDpi = stages + activeStage). */
    if (config_hid_pending && !config_hid_published) {
        if (config_hid_q_count >= CONFIG_HID_QUEUE_CAP) { irq_unlock(key); return -EBUSY; }
        uint8_t tail = (uint8_t)((config_hid_q_head + config_hid_q_count) % CONFIG_HID_QUEUE_CAP);
        memcpy(config_hid_queue[tail], *data, 64);
        config_hid_q_count++;
        irq_unlock(key);
        return 0;
    }
#else
    if (config_hid_locked_out || (config_hid_pending &&
        !(config_hid_published && config_hid_consumed))) { irq_unlock(key); return -EBUSY; }
#endif
    memcpy(config_hid_request, *data, 64);
    memcpy(config_hid_response, *data, 64);
    config_hid_response[0] = 0xa0;
    config_hid_claimed = config_hid_published = config_hid_consumed = false;
    config_hid_pending = true;
    irq_unlock(key);
    return 0;
}

static int config_hid_get(const struct device *dev, struct usb_setup_packet *setup,
                          int32_t *len, uint8_t **data)
{
    ARG_UNUSED(dev);
    if (!setup || !len || !data || setup->wValue != 0x0300 || setup->wLength != 64) return -EINVAL;
    unsigned int key = irq_lock();
    memcpy(config_hid_snapshot, config_hid_response, 64);
    if (config_hid_published) config_hid_consumed = true;
    irq_unlock(key);
    *data = config_hid_snapshot;
    *len = 64;
    return 0;
}

/* Main owns RF state; USB callbacks only touch the small IRQ-locked mailbox. */
static void config_hid_poll_link(bool mouse_linked)
{
    ARG_UNUSED(mouse_linked);
    unsigned int key = irq_lock();
    if (config_hid_pending && !config_hid_claimed) {
#ifdef CORE_PROTO_FULL
        if (!mouse_linked) {
            config_hid_response[0] = 0xa4; /* Receiver did not find mouse. */
            config_hid_claimed = config_hid_published = true;
            config_hid_query_active = false;
        } else {
            if (!config_read_begin(&config_read_state, config_hid_request)) config_read_state.failed = true;
            config_hid_claimed = config_hid_query_active = true;
            config_hid_deadline = k_uptime_get() + 4000;
        }
#else
        if (!config_read_begin(&config_read_state, config_hid_request)) config_read_state.failed = true;
        config_hid_claimed = config_hid_query_active = true;
        config_hid_deadline = k_uptime_get() + 4000;
#endif
    }
    if (config_hid_query_active && !config_hid_published) {
        if (!(config_read_state.complete && config_read_state.reply_released) &&
            k_uptime_get() >= config_hid_deadline) config_read_state.failed = true;
        if (config_read_state.complete && config_read_state.reply_released && !config_read_state.failed) {
            memcpy(config_hid_response, config_read_state.response, 64);
            config_hid_published = true;
#ifdef CORE_PROTO_FULL
            config_hid_query_active = false;
#endif
        } else if (config_read_state.failed) {
            config_hid_response[0] = 0xa2;
            config_hid_published = true;
#ifdef CORE_PROTO_FULL
            config_hid_query_active = false;
#else
            config_hid_locked_out = true;
#endif
        }
    }
#ifdef CORE_PROTO_FULL
    /* Drain queued back-to-back SET_REPORT requests as soon as the active RF slot finishes. */
    if (config_hid_published && !config_hid_query_active && config_hid_q_count > 0) {
        memcpy(config_hid_request, config_hid_queue[config_hid_q_head], 64);
        memcpy(config_hid_response, config_hid_request, 64);
        config_hid_response[0] = 0xa0;
        config_hid_q_head = (uint8_t)((config_hid_q_head + 1u) % CONFIG_HID_QUEUE_CAP);
        config_hid_q_count--;
        config_hid_claimed = config_hid_published = config_hid_consumed = false;
        config_hid_pending = true;
    }
#endif
    irq_unlock(key);
}

#ifndef CORE_PROTO_FULL
static void config_hid_poll(void)
{
    config_hid_poll_link(true);
}
#endif

static int init_config_hid(void)
{
    static const struct hid_ops ops = { .get_report = config_hid_get, .set_report = config_hid_set };
    const struct device *dev = device_get_binding("HID_1");
    if (!dev || !device_is_ready(dev)) return -ENODEV;
    config_hid_reset();
    usb_hid_register_device(dev, config_hid_descriptor, sizeof(config_hid_descriptor), &ops);
    return usb_hid_init(dev);
}
```

## src/config_read.h
```c
/* Prototype configuration allowlist; no address, updater or arbitrary writes. */
static const uint8_t config_read_version_request[64] = {0, 0, 2, 3, 0, 0x81};
#ifdef CORE_PROTO_FULL
static const uint8_t config_dongle_version_request[64] = {0, 0, 0, 3, 0, 0x81};
#endif
struct config_read {
    uint8_t offset, command_sequence, last_report, received;
    bool started, have_report, complete, failed, reply_released, configured;
    unsigned int attempts;
    uint8_t response[64];
    uint8_t request[64];
};

static inline bool config_request_valid(const uint8_t *p)
{
    if (!memcmp(p, config_read_version_request, 64)) return true;
#ifdef CORE_PROTO_FULL
    /* Receiver-local firmware version (target 0, group 0, op 0x81, any payload size <= 58). */
    if (p[0] == 0 && p[1] == 0 && p[2] == 0 && p[3] <= 58 && p[4] == 0 && p[5] == 0x81) {
        for (unsigned int i = 6; i < 64; i++) if (p[i] != 0) return false;
        return true;
    }
    /* Safe read-only getters (op >= 0x80) in groups 0..3 (excluding 00/82 RF address).
     * Allows flexible request size byte p[3] used by third-party WebHID tools like OpenMouse.
     */
    if (p[0] == 0 && p[1] == 0 && p[2] == 2 && p[3] <= 58 && p[4] <= 3 && (p[5] & 0x80u)) {
        if (p[4] == 0 && p[5] == 0x82) return false; /* Never expose RF address read. */
        return true;
    }
#endif
    uint8_t expected[64] = {0,0,2,1,0,0,0};
    expected[4] = p[4]; expected[5] = p[5];
    bool profile_read = false;
    switch (((unsigned int)p[4] << 8) | p[5]) {
    case 0x0085: case 0x0180: case 0x0188: break; /* Global profile/poll/LOD getters. */
#ifdef CORE_PROTO_FULL
    case 0x0083: expected[3] = 2; break; /* Battery status getter. */
    case 0x0005: /* Active profile setter (1..3). */
        if (p[6] < 1 || p[6] > 3) return false;
        expected[3] = 1; expected[6] = p[6];
        break;
    case 0x0008: /* Profile debounce setter (profile 1..3, 0..32 ms). */
        if (p[6] < 1 || p[6] > 3 || p[7] > 32) return false;
        expected[3] = 2; expected[6] = p[6]; expected[7] = p[7];
        break;
    case 0x0100: /* Polling divider setter (1/2/4/8 = 1000/500/250/125 Hz). */
        if (p[6] != 1 && p[6] != 2 && p[6] != 4 && p[6] != 8) return false;
        expected[3] = 1; expected[6] = p[6];
        break;
    case 0x0107: /* OpenMouse / classic lift-off distance setter (0=1mm, 1=2mm). */
        if (p[6] > 1) return false;
        expected[3] = 1; expected[6] = p[6];
        break;
    case 0x0108: /* CORE lift-off distance setter (1 or 2 mm). */
        if (p[6] != 1 && p[6] != 2) return false;
        expected[3] = 1; expected[6] = p[6];
        break;
    case 0x0201: /* Six DPI-indicator RGB entries per profile (1..3). */
        if (p[6] < 1 || p[6] > 3) return false;
        expected[3] = 19; expected[6] = p[6];
        memcpy(expected + 7, p + 7, 18);
        break;
    case 0x0300: { /* Slot-0 button binding setter (profile 1..3, 8 known buttons). */
        static const uint8_t buttons[] = {1,3,2,5,4,0x14,0x10,0x11};
        bool found = false;
        for (unsigned int i = 0; i < sizeof(buttons); i++) if (p[7] == buttons[i]) found = true;
        if (!found || p[6] < 1 || p[6] > 3 || p[8] != 0) return false;
        expected[3] = 10; expected[6] = p[6]; expected[7] = p[7]; expected[8] = 0;
        memcpy(expected + 9, p + 9, 7);
        break;
    }
#endif
    case 0x0181: case 0x0182: profile_read = true; break;
    case 0x0281: expected[3] = 19; profile_read = true; break; /* Six DPI colours. */
    case 0x0088: expected[3] = 2; profile_read = true; break; /* Profile debounce. */
    case 0x0380: {
        static const uint8_t buttons[] = {1,3,2,5,4,0x14,0x10,0x11};
        bool found = false;
        for (unsigned int i = 0; i < sizeof(buttons); i++) if (p[7] == buttons[i]) found = true;
        if (!found) return false;
        expected[3] = 10; expected[7] = p[7]; profile_read = true;
        break; /* Slot0 only; remaining padding must be zero. */
    }
    case 0x0101:
#ifdef CORE_PROTO_FULL
        if (p[6] < 1 || p[6] > 3 || p[7] < 1 || p[7] > 6) return false;
        expected[3] = (uint8_t)(p[7] * 4u + 2u); expected[6] = p[6]; expected[7] = p[7];
        for (unsigned int at = 8; at < 8u + (unsigned int)p[7] * 4u; at += 2) {
            unsigned int dpi = (unsigned int)p[at] * 256u + p[at + 1];
            if (dpi < 50 || dpi > 19000 || dpi % 50) return false;
            expected[at] = p[at]; expected[at + 1] = p[at + 1];
        }
#else
        /* Qualify profile1 with its existing four stages before enabling CORE writes. */
        if (p[6] != 1 || p[7] != 4) return false;
        expected[3] = 18; expected[6] = 1; expected[7] = 4;
        for (unsigned int at = 8; at < 24; at += 2) {
            unsigned int dpi = (unsigned int)p[at] * 256u + p[at + 1];
            if (dpi < 50 || dpi > 19000 || dpi % 50) return false;
            expected[at] = p[at]; expected[at + 1] = p[at + 1];
        }
#endif
        break;
    case 0x0102:
#ifdef CORE_PROTO_FULL
        if (p[6] < 1 || p[6] > 3 || p[7] < 1 || p[7] > 6) return false;
        expected[3] = 2; expected[6] = p[6]; expected[7] = p[7];
#else
        /* shortcut: current profile has four stages; qualify other profiles separately. */
        if (p[7] < 1 || p[7] > 4) return false;
        expected[3] = 2; expected[6] = 1; expected[7] = p[7];
#endif
        break;
    default: return false;
    }
    if (profile_read) {
        if (p[6] < 1 || p[6] > 3) return false;
        expected[6] = p[6];
    }
    return !memcmp(p, expected, 64);
}

static inline bool config_read_begin(struct config_read *s, const uint8_t *request)
{
    if (!config_request_valid(request)) return false;
    memset(s, 0, sizeof(*s));
    memcpy(s->request, request, 64);
    s->configured = true;
    return true;
}

static bool config_read_frame_valid(const uint8_t *p)
{
    if (p[0] < 2 || p[0] > 64) return false;
    unsigned int at = 3;
    while (at <= p[0]) {
        uint8_t header = p[at++];
        unsigned int length = (header >> 3) & 15u, type = header & 7u;
#ifdef CORE_PROTO_FULL
        bool cont = (header & 0x80u) != 0;
        bool ok = (!cont && ((type == 1 && length == 8) || (type == 2 && length == 8) ||
                             (type == 3 && length == 2) || (type == 4 && length == 1) ||
                             (type == 5 && length == 8) || (type == 6 && length == 8))) ||
                  (type == 7 && length == 8);
        if (!ok || at + length > (unsigned int)p[0] + 1) return false;
#else
        if (length != 8 || (type != 1 && type != 5 && type != 7) ||
            at + length > (unsigned int)p[0] + 1) return false;
#endif
        at += length;
    }
    return at == (unsigned int)p[0] + 1;
}

static unsigned int config_read_ack(struct config_read *s, const uint8_t *p, uint8_t *ack)
{
    /* Data queue and command stream have independent acknowledgements. */
    ack[0] = 2;
    ack[1] = p[0] == 2 ? p[1] : (uint8_t)(p[1] + 1);
    ack[2] = p[2] & 63u;
    if (s->failed || s->complete) return 3;
    if (!s->started) {
        s->started = true;
        s->command_sequence = ack[2];
    } else if (ack[2] != s->command_sequence) {
        if (s->offset == 64 || ack[2] != (s->command_sequence + 1u) % 63u) {
            s->failed = true;
            return 3;
        }
        s->offset += 8;
        s->command_sequence = ack[2];
    }
    if (s->offset == 64) return 3;
    if (s->attempts == 512) {
        s->failed = true;
        return 3;
    }
    s->attempts++;
    ack[0] = 12;
    ack[3] = s->offset == 56 ? 0x4f : 0xcf; /* Type7, offset+8 data, continuation. */
    ack[4] = s->offset;
    const uint8_t *request = s->configured ? s->request : config_read_version_request;
    memcpy(ack + 5, request + s->offset, 8);
    return 13;
}

static void config_read_receive(struct config_read *s, const uint8_t *p)
{
    if (s->failed) return;
    if (!config_read_frame_valid(p)) { s->failed = true; return; }
    if (s->complete) {
        if (s->reply_released) return;
        if (p[1] == (uint8_t)(s->last_report + 1)) s->reply_released = true;
        else if (p[1] != s->last_report) s->failed = true;
        return;
    }
    if (p[0] == 2) return;
    if (s->have_report) {
        if (p[1] == s->last_report) return;
        if (p[1] != (uint8_t)(s->last_report + 1)) { s->failed = true; return; }
    }
    s->last_report = p[1];
    s->have_report = true;
    for (unsigned int at = 3; at <= p[0];) {
        uint8_t header = p[at++];
        unsigned int len = (header >> 3) & 15u;
        const uint8_t *chunk = p + at;
        at += len;
        if ((header & 7u) != 7) continue;
        if (s->offset != 64 || s->received > 56) { s->failed = true; return; }
        memcpy(s->response + s->received, chunk, 8);
        s->received += 8;
        if (!(header & 128u)) {
            const uint8_t *request = s->configured ? s->request : config_read_version_request;
            unsigned int payload = s->response[3];
            unsigned int padded = (6u + payload + 7u) & ~7u;
#ifdef CORE_PROTO_FULL
            bool ok_status = (s->response[0] == 0xa1 || s->response[0] == 0xa3);
            if (payload > 58 || s->received != padded || !ok_status ||
                s->response[2] != request[2] || s->response[4] != request[4] ||
                s->response[5] != request[5] ||
                (s->response[0] == 0xa1 && request[4] == 1 && request[5] == 2 &&
                 (payload != 2 || memcmp(s->response + 6, request + 6, 2))) ||
                (s->response[0] == 0xa1 && request[4] == 1 && request[5] == 1 &&
                 (payload != request[3] || memcmp(s->response + 6, request + 6, request[3])))) s->failed = true;
            else s->complete = true;
#else
            if (payload > 58 || s->received != padded || s->response[0] != 0xa1 ||
                s->response[2] != request[2] || s->response[4] != request[4] ||
                s->response[5] != request[5] ||
                (request[4] == 1 && request[5] == 2 &&
                 (payload != 2 || memcmp(s->response + 6, request + 6, 2))) ||
                (request[4] == 1 && request[5] == 1 &&
                 (payload != request[3] || memcmp(s->response + 6, request + 6, request[3])))) s->failed = true;
            else s->complete = true;
#endif
            return;
        }
    }
}
```

## src/input_totals.h
```c
#include <stdbool.h>
#include <stdint.h>
#include <string.h>

#define INPUT_TOTALS_CAP 1000000u
/* Main-thread only: accepted input, neutralization, reset and stopped-only dump. */
static struct {
    uint32_t reports, unchanged, neutral_reports;
    int64_t dx, dy, wheel;
    uint8_t buttons;
    uint32_t down[5], up[5], neutral_up[5];
} input_totals;
static bool input_totals_capped;

static void input_totals_reset(void)
{
    memset(&input_totals, 0, sizeof(input_totals));
    input_totals_capped = false;
}

static void input_totals_record(const uint8_t report[6])
{
    if (input_totals.reports == INPUT_TOTALS_CAP) { input_totals_capped = true; return; }
    uint32_t x = report[1] | ((uint32_t)report[2] << 8);
    uint32_t y = report[3] | ((uint32_t)report[4] << 8);
    int32_t dx = x >= 0x8000 ? (int32_t)x - 0x10000 : (int32_t)x;
    int32_t dy = y >= 0x8000 ? (int32_t)y - 0x10000 : (int32_t)y;
    int32_t wheel = report[5] >= 0x80 ? (int32_t)report[5] - 0x100 : report[5];
    uint8_t buttons = report[0] & 31;
    if (!dx && !dy && !wheel && buttons == input_totals.buttons) input_totals.unchanged++;
    for (unsigned int i = 0; i < 5; i++) {
        uint8_t bit = 1u << i;
        if ((buttons & bit) && !(input_totals.buttons & bit)) input_totals.down[i]++;
        if (!(buttons & bit) && (input_totals.buttons & bit)) input_totals.up[i]++;
    }
    input_totals.reports++;
    input_totals.dx += dx;
    input_totals.dy += dy;
    input_totals.wheel += wheel;
    input_totals.buttons = buttons;
}

static void input_totals_neutral(void)
{
    if (input_totals.neutral_reports == INPUT_TOTALS_CAP) { input_totals_capped = true; return; }
    input_totals.neutral_reports++;
    for (unsigned int i = 0; i < 5; i++) {
        if (input_totals.buttons & (1u << i)) input_totals.neutral_up[i]++;
    }
    input_totals.buttons = 0;
}
```

## src/latency_metrics.h
```c
#include <stdbool.h>
#include <stdint.h>
#include <string.h>

#define LATENCY_BINS 9u
#define LATENCY_COUNT_CAP 1000000u
enum latency_metric { LAT_CANDIDATE, LAT_RF_SUBMIT, LAT_SUBMIT_USB, LAT_RF_USB,
                      LAT_ACK_READY, LAT_ACK_END, LAT_METRIC_COUNT };
struct latency_histogram {
    uint32_t count, maximum, bins[LATENCY_BINS];
    uint64_t sum;
};
static struct latency_histogram latency_metrics[LAT_METRIC_COUNT];
static bool latency_capped;
static void latency_histogram_add(struct latency_histogram *h, uint32_t us)
{
    static const uint32_t upper[] = {50,100,250,500,1000,2000,4000,8000};
    if (h->count == LATENCY_COUNT_CAP) {
        latency_capped = true;
        return;
    }
    unsigned int bin = 0;
    while (bin < LATENCY_BINS - 1 && us > upper[bin]) bin++;
    h->count++;
    h->sum += us;
    if (us > h->maximum) h->maximum = us;
    h->bins[bin]++;
}

static void latency_add(enum latency_metric metric, uint32_t us)
{
    latency_histogram_add(&latency_metrics[metric], us);
}

#ifdef USB_PHASE_DIAGNOSTICS
static struct latency_histogram phase_metrics[11];
static uint64_t phase_rf_submit[11];
static unsigned int latency_phase_bucket(uint32_t before, uint32_t submit, uint32_t after)
{
    uint32_t age = submit - before;
    return usb_phase_calibrated && before == after && age < 1000 ? age / 100 : 10;
}
#endif

static bool latency_collect, latency_rx_valid, latency_tracking_fault;
static uint32_t latency_rx_us, latency_failed_submissions;
static struct {
    bool active, accepted, completed;
    uint32_t rx_us, submit_us, complete_us;
#ifdef USB_PHASE_DIAGNOSTICS
    unsigned int phase;
#endif
} latency_pending;

static bool latency_reset(void)
{
    unsigned int key = irq_lock();
    if (latency_pending.active) { irq_unlock(key); return false; }
    memset(latency_metrics, 0, sizeof(latency_metrics));
#ifdef USB_PHASE_DIAGNOSTICS
    memset(phase_metrics, 0, sizeof(phase_metrics));
    memset(phase_rf_submit, 0, sizeof(phase_rf_submit));
#endif
#ifdef INPUT_CONSERVATION
    input_totals_reset();
#endif
    latency_capped = latency_rx_valid = latency_tracking_fault = false;
    latency_failed_submissions = 0;
    latency_collect = true;
    irq_unlock(key);
    return true;
}

static void latency_observe_rx(uint32_t rx_us)
{
    unsigned int key = irq_lock();
    if (latency_collect) {
        latency_rx_us = rx_us;
        latency_rx_valid = true;
        latency_add(LAT_CANDIDATE, latency_clock_us() - rx_us);
    }
    irq_unlock(key);
}

static bool latency_submit_begin(void)
{
    unsigned int key = irq_lock();
    if (!latency_collect || !latency_rx_valid) { irq_unlock(key); return false; }
    if (latency_pending.active) {
        latency_tracking_fault = true;
        latency_collect = latency_rx_valid = latency_pending.active = false;
        irq_unlock(key);
        return false;
    }
    latency_pending.rx_us = latency_rx_us;
#ifdef USB_PHASE_DIAGNOSTICS
    uint32_t sof = latency_sof_us();
#endif
    latency_pending.submit_us = latency_clock_us();
#ifdef USB_PHASE_DIAGNOSTICS
    latency_pending.phase = latency_phase_bucket(sof, latency_pending.submit_us, latency_sof_us());
#endif
    latency_pending.accepted = latency_pending.completed = false;
    latency_pending.active = true;
    irq_unlock(key);
    return true;
}

/* Caller owns the short IRQ lock; USB completion may precede write return. */
static void latency_finish_pending(void)
{
    latency_add(LAT_SUBMIT_USB, latency_pending.complete_us - latency_pending.submit_us);
    latency_add(LAT_RF_USB, latency_pending.complete_us - latency_pending.rx_us);
#ifdef USB_PHASE_DIAGNOSTICS
    unsigned int phase = latency_pending.phase;
    latency_histogram_add(&phase_metrics[phase], latency_pending.complete_us - latency_pending.rx_us);
    phase_rf_submit[phase] += latency_pending.submit_us - latency_pending.rx_us;
#endif
    latency_pending.active = false;
}

static void latency_submit_result(bool measured, bool accepted)
{
    if (!measured) return;
    unsigned int key = irq_lock();
    if (latency_pending.active) {
        if (!accepted) {
            if (latency_failed_submissions != UINT32_MAX) latency_failed_submissions++;
            latency_pending.active = false;
        } else {
            latency_pending.accepted = true;
            latency_add(LAT_RF_SUBMIT, latency_pending.submit_us - latency_pending.rx_us);
            if (latency_pending.completed) latency_finish_pending();
        }
    }
    irq_unlock(key);
}

static void latency_usb_complete(void)
{
    unsigned int key = irq_lock();
    if (latency_pending.active && !latency_pending.completed) {
        latency_pending.complete_us = latency_clock_us();
        latency_pending.completed = true;
        if (latency_pending.accepted) latency_finish_pending();
    }
    irq_unlock(key);
}

static void latency_ack(uint32_t rx_us, uint32_t ready_us, uint32_t end_us)
{
    unsigned int key = irq_lock();
    if (latency_collect) {
        latency_add(LAT_ACK_READY, ready_us - rx_us);
        latency_add(LAT_ACK_END, end_us - rx_us);
    }
    irq_unlock(key);
}

static void latency_stop(void)
{
    unsigned int key = irq_lock();
    latency_collect = false;
    irq_unlock(key);
}

static bool latency_dump_ready(void)
{
    unsigned int key = irq_lock();
    bool ready = !latency_collect && !latency_pending.active;
    irq_unlock(key);
    return ready;
}
```
